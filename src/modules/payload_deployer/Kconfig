## src/modules/payload_deployer/Kconfig
```kconfig
menuconfig MODULES_PAYLOAD_DEPLOYER
	bool "payload_deployer"
	default n
	---help---
		Enable payload_deployer module
```

## src/tracker_pub/Kconfig
```kconfig
menuconfig EXAMPLES_TRACKER_PUB
	bool "tracker_pub"
	default n
	---help---
		Enable support for tracker_pub
```
